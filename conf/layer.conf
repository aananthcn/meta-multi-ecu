## conf/layer.conf
```bitbake
# We have a conf and classes directory, add to BBPATH
BBPATH .= ":${LAYERDIR}"

# We have recipes-* directories, add to BBFILES
BBFILES += "${LAYERDIR}/layers/multi-ecu/recipes-*/*/*.bb \
	${LAYERDIR}/layers/multi-ecu/recipes-*/*/*.bbappend"

BBFILE_COLLECTIONS += "multi_ecu"
BBFILE_PATTERN_multi_ecu = "^${LAYERDIR}/"
BBFILE_PRIORITY_multi_ecu = "6"
```

## layers/multi-ecu/conf/layer.conf
```bitbake
# We have a conf and classes directory, add to BBPATH
BBPATH .= ":${LAYERDIR}"

# We have recipes-* directories, add to BBFILES
BBFILES += "${LAYERDIR}/recipes-*/*/*.bb \
	${LAYERDIR}/recipes-*/*/*.bbappend"

BBFILE_COLLECTIONS += "multi_ecu"
BBFILE_PATTERN_multi_ecu = "^${LAYERDIR}/"
BBFILE_PRIORITY_multi_ecu = "6"
```
